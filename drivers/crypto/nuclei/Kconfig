## drivers/crypto/nuclei/Kconfig
```kconfig
# SPDX-License-Identifier: GPL-2.0-only
config CRYPTO_DEV_NUCLEI
	tristate "Nuclei Cryptographic Engine through HSM"
	depends on OF
	depends on NUCLEI_MAILBOX
	select CRYPTO_ECB
	select CRYPTO_CBC
	select CRYPTO_DES
	select CRYPTO_AES
	select CRYPTO_SM4_GENERIC
	select CRYPTO_ENGINE
	select CRYPTO_LIB_DES
	select CRYPTO_MD5
	select CRYPTO_SHA1
	select CRYPTO_SHA256
	select CRYPTO_HASH
	select CRYPTO_SKCIPHER
	select CRYPTO_HMAC

	help
	  This driver interfaces with the nuclei hsm hardware crypto accelerator.
	  Supporting cbc/ecb chainmode, and aes/sm4 cipher mode.
```

## drivers/net/ethernet/nuclei/Kconfig
```kconfig
# SPDX-License-Identifier: GPL-2.0-only
config NUCLEI_XEC
	tristate "Nuclei Ethernet MAC"
	select PHYLIB
	select CRC32
	help
	  Say Y or M here if you want to use the Nuclei ethernet MAC.
	  Also available as a module.
```

## drivers/pinctrl/nuclei/Kconfig
```kconfig
# SPDX-License-Identifier: GPL-2.0-only
config PINCTRL_NUCLEI
	tristate
	depends on OF
	select GENERIC_PINCTRL_GROUPS
	select GENERIC_PINMUX_FUNCTIONS
	select PINCONF
	select GENERIC_PINCONF

config PINCTRL_NUCLEI_T0
	bool "NUCLEI T0 pinctrl driver"
	select PINCTRL_NUCLEI
	help
	  Say Y here to enable the NUCLEI pinctrl driver
```
